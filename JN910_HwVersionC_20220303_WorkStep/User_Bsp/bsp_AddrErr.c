/**********************************************************************************************************
** Company     : JNE WuHan Co.,Ltd.
** Project     :
** --------------------------------------------------------------------------------------------------------
** File name   : bsp_AdrrErr.c
** Author      : Huang Cheng
** Date        : 2022-01-14
** Description : bsp_AdrrErr source file
**********************************************************************************************************/

/**********************************************************************************************************
**                                          头文件引用区
**********************************************************************************************************/
#include "bsp_i2c.h"
#include "bsp_pca9555.h"
#include "bsp_AddrErr.h"

/**********************************************************************************************************
**                                         全局变量定义区
**********************************************************************************************************/
static uint8_t I2cPcaIntAddr = 0x00;                    //I2C控制拨码的设备号

/* 拨码开关的I2C设备参数 */
static I2C_ParamType IntAddrParam = 
{
	I2C3_SCL_GPIO_Port,
	I2C3_SCL_Pin,
	I2C3_SDA_GPIO_Port,
	I2C3_SDA_Pin,
	2,
};

static I2C_UserFuncType *I2C_IntAddr = &I2C_UserFunc;  //I2C设备创建句柄

/**********************************************************************************************************
**                                           函数声明区
**********************************************************************************************************/
static uint32_t Bit_Reverse(uint32_t Value, Value_Type ValType);

/**********************************************************************************************************
**                                           应用函数区
**********************************************************************************************************/
/**********************************************************************************************************
**	函 数 名 : Bit_Reverse()
**	功能说明 : 反转一个数的bit位
**	形    参 : Value - 带反转的数，ValType - 该数的类型
**	返 回 值 : RevVal - 反转结果
**********************************************************************************************************/
static uint32_t Bit_Reverse(uint32_t Value, Value_Type ValType)
{
	uint8_t BitArr[32] = {0};
	uint32_t RevVal = 0;
	
	for(uint8_t i = 0; i < (ValType*8); i++)
	{
		BitArr[i] = (Value>>i) & 0x01;
	}
	
	for(uint8_t i = 0; i < (ValType*8); i++)
	{
		RevVal |= BitArr[ValType*8-i-1] << i;
	}
	
	return RevVal;
}

/**********************************************************************************************************
**	函 数 名 : bsp_AddrErrInit()
**	功能说明 : 拨码开关和故障信号读取初始化函数
**	形    参 : 无
**	返 回 值 : 无
**********************************************************************************************************/
void bsp_AddrErrInit(void)
{
	uint8_t CreateSta = 0x00;
	
	//创建拨码I2C设备
	CreateSta = I2C_IntAddr->Create(&IntAddrParam, &I2cPcaIntAddr);
	
	//创建设备成功
	if(I2C_DEVICE_OK == CreateSta)
	{
		PCA9555_ConfigInputReg(I2cPcaIntAddr);
	}
	else
	{
		//do nothing;
	}
}

/**********************************************************************************************************
**	函 数 名 : bsp_AddrRead()
**	功能说明 : 拨码开关读取函数
**	形    参 : 无
**	返 回 值 : 拨码开关值
**********************************************************************************************************/
uint8_t bsp_AddrRead(void)
{
	static uint8_t ReadData[2] = {0};
	
	Pca9555_RegRead(I2cPcaIntAddr, ReadData);
	
	return (ReadData[0]);
}

/**********************************************************************************************************
**	函 数 名 : bsp_HwErrRead()
**	功能说明 : 硬件故障读取函数
**	形    参 : 无
**	返 回 值 : 硬件故障值
**********************************************************************************************************/
uint8_t bsp_HwErrRead(void)
{
	static uint8_t ReadData[2] = {0};
	
	Pca9555_RegRead(I2cPcaIntAddr, ReadData);
	
	return (Bit_Reverse(ReadData[1], SingleByte));
}

/**********************************************************************************************************
**	函 数 名 : bsp_OcfDetect()
**	功能说明 : 过流故障检测函数
**	形    参 : 无
**	返 回 值 : 1 - 故障，0 - 无故障
**********************************************************************************************************/
Curt_StaType bsp_OcfDetect(void)
{
	Curt_StaType CurtSta = Curt_Ok;
	
	if(0x00 == HAL_GPIO_ReadPin(STM32_EXTI_INT_GPIO_Port, STM32_EXTI_INT_Pin))
	{
		bsp_DelayMS(1);
		
		if(0x00 == HAL_GPIO_ReadPin(STM32_EXTI_INT_GPIO_Port, STM32_EXTI_INT_Pin))
		{
			CurtSta = Curt_Fault;
		}
	}
	
	return CurtSta;
}

/**********************************************************************************************************
**                                          End Of File
**********************************************************************************************************/

