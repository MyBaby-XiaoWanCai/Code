/**********************************************************************************************************
** Company     : JNE WuHan Co.,Ltd.
** Project     :
** --------------------------------------------------------------------------------------------------------
** File name   : bsp_MB85RS2.c
** Author      : Huang Cheng
** Date        : 2021-11-09
** Description : bsp_MB85RS2 source file
**********************************************************************************************************/

/**********************************************************************************************************
**                                          头文件引用区
**********************************************************************************************************/
#include "main.h"

/**********************************************************************************************************
**                                         全局变量定义区
**********************************************************************************************************/
__IO uint8_t Fram_Op=0; //铁电操作标志 1：正在操作， 0:没有操作

/**********************************************************************************************************
**                                           函数声明区
**********************************************************************************************************/
static uint8_t SPI_ReadWriteByte(uint8_t data);

/**********************************************************************************************************
**                                           应用函数区
**********************************************************************************************************/
/*
*********************************************************************************************************
*   函 数 名: SPI_ReadWriteByte
*   功能说明: SPI字节读写
*   形    参: data：主机发送数据
*   返 回 值: 从机返回数据
*********************************************************************************************************
*/
static uint8_t SPI_ReadWriteByte(uint8_t data)
{
    uint8_t Rx_data = 0;
    SPI_TransmitReceive(MB85R_SPI_UNIT, &data, &Rx_data, 1);
    bsp_DelayUS(1);    
    return Rx_data;
}

/*
*********************************************************************************************************
*   函 数 名: MB85Ctrl_Write
*   功能说明: 往FRAM指定地址写数据
*   形    参: addr：要写入的地址，buf：要写入的数据指针，len：数据长度字节
*   返 回 值: 无
*********************************************************************************************************
*/
void MB85Ctrl_Write(uint32_t addr, uint8_t *buf, uint16_t len)
{
    uint8_t addr_H, addr_M, addr_L;

    addr_H = (uint8_t)((addr & 0xff0000) >> 16);
    addr_M = (uint8_t)((addr & 0xff00) >> 8);
    addr_L = (uint8_t)(addr & 0x00ff);

    MB85R_NSS_0();
    SPI_ReadWriteByte(MB85RS2_CMD_WREN);
    MB85R_NSS_1();

    bsp_DelayUS(1);
    MB85R_NSS_0();
    SPI_ReadWriteByte(MB85RS2_CMD_WRITE);
    SPI_ReadWriteByte(addr_H);
    SPI_ReadWriteByte(addr_M);
    SPI_ReadWriteByte(addr_L);

    for(; len > 0; len--)
    {
        SPI_ReadWriteByte(*buf++);
    }
    MB85R_NSS_1();
}

/*
*********************************************************************************************************
*   函 数 名: MB85Ctrl_Read
*   功能说明: 读出FRAM指定地址数据
*   形    参: addr：要读出的地址，buf：读出的数据存储指针，len：数据长度字节
*   返 回 值: 无
*********************************************************************************************************
*/
void MB85Ctrl_Read(uint32_t addr, uint8_t *buf, uint16_t len)
{
    uint8_t addr_H, addr_M, addr_L;

    addr_H = (uint8_t)((addr & 0xff0000) >> 16);
    addr_M = (uint8_t)((addr & 0xff00) >> 8);
    addr_L = (uint8_t)(addr & 0x00ff);

    MB85R_NSS_0();
    SPI_ReadWriteByte(MB85RS2_CMD_READ);
    SPI_ReadWriteByte(addr_H);
    SPI_ReadWriteByte(addr_M);
    SPI_ReadWriteByte(addr_L);

    for(; len > 0; len--)
    {
        *buf++ = SPI_ReadWriteByte(0x00);
    }
    MB85R_NSS_1();
}

/*
*********************************************************************************************************
*   函 数 名: MB85Ctrl_ReadID
*   功能说明: 读出FRAM厂家32位制造ID
*   形    参: buf：读出的数据存储指针
*   返 回 值: 无
*********************************************************************************************************
*/
void MB85Ctrl_ReadID(uint32_t *buf)
{
    uint8_t i;
    uint8_t bytebuf[4]= {0};
	
    MB85R_NSS_0();
    SPI_ReadWriteByte(MB85RS2_CMD_RDID);
    for(i=0; i < 4; i++)
    {
        bytebuf[i] = SPI_ReadWriteByte(0x00);
    }
    *buf=(bytebuf[0]<<24)+(bytebuf[1]<<16)+(bytebuf[2]<<8)+(bytebuf[3]);
    MB85R_NSS_1();
}

/*
*********************************************************************************************************
*   函 数 名: MB85Ctrl_CheckWrite
*   功能说明: 往FRAM指定地址写数据,并读出检查确认写入是否正确
*   形    参: addr：要写入的地址，buf：要写入的数据指针，len：数据长度字节
*   返 回 值: 1：写入成功，0：写入失败
*********************************************************************************************************
*/
uint8_t MB85Ctrl_CheckWrite(uint32_t addr, uint8_t *buf, uint16_t len)
{

	int32_t ls, us;
	Fram_Op=1;
	Dis_int();
	ls = osKernelLock();
#if 0     /*使用malloc,free，可用以下代码*/
	uint8_t *date = (uint8_t *)malloc(len);
	uint8_t i;
	uint8_t eq = 1;
	MB85Ctrl_Write(addr, buf, len);
	MB85Ctrl_Read(addr, date, len);

	for(i = 0; i < len; i++)
	{
		if(date[i] != buf[i])
		{
			eq = 0;
			break;
		}
	}
	free(date);
	return eq;
#elif 1
	/*不使用malloc,free，可用以下代码*/
	uint8_t date;
	uint16_t i;
	uint8_t eq = 1;
	MB85Ctrl_Write(addr, buf, len);
	for(i = 0; i < len; i++)
	{
		MB85Ctrl_Read(addr + i, &date, 1);
		if(date != buf[i])
		{
			eq = 0;
			
			for(uint8_t j = 0; j < CHANNEL_CFG; j++)
			{ 
				IP_Alarm_Flag[j] |= IntelProtect_FRE; 
			} //fram故障
			
			break;
		}
	}

	us = osKernelUnlock();
	osKernelRestoreLock(us);
	osKernelRestoreLock(ls);
	osDelay(1);
	Fram_Op=0;   
	En_int();
	
	return eq;
#endif
}


/**********************************************************************************************************
**  函 数 名: WorkStatusFramRecord()
**  功能说明: 将当前工步状态写入FRAM
**  形    参:
**  返 回 值: 1成功，2失败
**********************************************************************************************************/
uint8_t WorkStatusFramRecord(void)
{
    uint32_t StartAdd;
    uint8_t j;
    StartAdd = StartADD_WorkStatus; //工步状态记录地址
    for(j = 0; j < 8; j++)
    {
        if(0 == MB85Ctrl_CheckWrite(StartAdd + j, &Tier2.workstep[j].Status, 1))
        {
            return 0;
        }
    }
    return 1;
}

/**********************************************************************************************************
**  函 数 名: WorkRunTimeFramRecord()
**  功能说明: 将当前运行时间写入FRAM
**  形    参:
**  返 回 值: 1成功，2失败
**********************************************************************************************************/
uint8_t WorkRunTimeFramRecord(void)
{
    return 1;
}

/**********************************************************************************************************
**  函 数 名: CapacityFramRecord()
**  功能说明: 将当前充电容量写入FRAM
**  形    参:
**  返 回 值: 1成功，2失败
**********************************************************************************************************/
uint8_t CapacityFramRecord(void)
{
    return 1;
}
/**********************************************************************************************************
**  函 数 名: EnergyFramRecord()
**  功能说明: 将当前充电能量写入FRAM
**  形    参:
**  返 回 值: 1成功，2失败
**********************************************************************************************************/
uint8_t EnergyFramRecord(void)
{
    return 1;
}

/**********************************************************************************************************
**                                          End Of File
**********************************************************************************************************/
