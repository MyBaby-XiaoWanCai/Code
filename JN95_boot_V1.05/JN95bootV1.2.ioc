# file: JN95bootV1.2.ioc
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ADC3.Channel-0\#ChannelRegularConversion=ADC_CHANNEL_14
ADC3.NbrOfConversionFlag=1
ADC3.Rank-0\#ChannelRegularConversion=1
ADC3.SamplingTime-0\#ChannelRegularConversion=ADC_SAMPLETIME_3CYCLES
CAN1.BS1=CAN_BS1_16TQ
CAN1.BS2=CAN_BS2_3TQ
CAN1.CalculateBaudRate=125000
CAN1.CalculateTimeBit=8000.00
CAN1.CalculateTimeQuantum=400.0
CAN1.Prescaler=18
CAN2.BS1=CAN_BS1_16TQ
CAN2.BS2=CAN_BS2_3TQ
CAN2.CalculateBaudRate=125000
CAN2.CalculateTimeBit=8000.00
CAN2.CalculateTimeQuantum=400.0
CAN2.Prescaler=18
IWDG.Prescaler=IWDG_PRESCALER_64
Mcu.Family=STM32F4
Mcu.Name=STM32F429I(E-G)Tx
Mcu.Package=LQFP176
NVIC.EXTI0_IRQn=true\:0\:0\:true\:false\:true\:true\:true
NVIC.EXTI1_IRQn=true\:0\:0\:true\:false\:true\:true\:true
NVIC.PriorityGroup=NVIC_PRIORITYGROUP_4
NVIC.TIM4_IRQn=true\:0\:0\:false\:false\:true\:true\:true
NVIC.TIM7_IRQn=true\:0\:0\:false\:false\:true\:false\:true
NVIC.TimeBase=TIM7_IRQn
NVIC.TimeBaseIP=TIM7
PA0/WKUP.GPIO_Label=M_Loop7
PA0/WKUP.GPIO_PuPd=GPIO_PULLDOWN
PA0/WKUP.PinState=GPIO_PIN_RESET
PA0/WKUP.Signal=GPIO_Output
PA1.GPIO_Label=CH8_G
PA1.Signal=GPIO_Output
PA10.GPIO_Label=M_Loop1
PA10.GPIO_PuPd=GPIO_PULLDOWN
PA10.Signal=GPIO_Output
PA11.Mode=CAN_Activate
PA11.Signal=CAN1_RX
PA12.Mode=CAN_Activate
PA12.Signal=CAN1_TX
PA15.GPIO_Label=M_Loop2
PA15.GPIO_PuPd=GPIO_PULLDOWN
PA15.Signal=GPIO_Output
PA2.GPIO_Label=CH8_R
PA2.Signal=GPIO_Output
PA3.GPIO_Label=AD_Amb
PA3.Signal=SharedAnalog_PA3
PA4.GPIO_Label=M_Loop8
PA4.GPIO_PuPd=GPIO_PULLDOWN
PA4.Signal=GPIO_Output
PA5.GPIO_Label=CH5_G
PA5.Signal=GPIO_Output
PA6.GPIO_Label=CH5_R
PA6.Signal=GPIO_Output
PA7.GPIO_Label=CH7_G
PA7.Signal=GPIO_Input
PA8.GPIO_Label=MOD_REV7
PA8.PinState=GPIO_PIN_SET
PA8.Signal=GPIO_Output
PA9.GPIO_Label=MOD_REV8
PA9.PinState=GPIO_PIN_SET
PA9.Signal=GPIO_Output
PB0.GPIO_Label=MOD_PG8
PB0.Signal=GPIO_Input
PB1.GPIO_Label=MOD_PG7
PB1.Signal=GPIO_Input
PB10.GPIO_Label=ADD_2
PB10.GPIO_PuPd=GPIO_PULLDOWN
PB10.Signal=GPIO_Input
PB11.GPIO_Label=CH6_G
PB11.Signal=GPIO_Output
PB12.Mode=CAN_Activate
PB12.Signal=CAN2_RX
PB13.Mode=CAN_Activate
PB13.Signal=CAN2_TX
PB14.GPIO_Label=MOD_EN5
PB14.GPIO_PuPd=GPIO_PULLDOWN
PB14.PinState=GPIO_PIN_RESET
PB14.Signal=GPIO_Output
PB15.GPIO_Label=Flash_CS
PB15.GPIO_PuPd=GPIO_PULLDOWN
PB15.GPIO_Speed=GPIO_SPEED_FREQ_HIGH
PB15.Signal=GPIO_Output
PB2/BOOT1.GPIO_Label=WDG_OUT
PB2/BOOT1.Signal=GPIO_Output
PB3.GPIO_Label=W5500_SCK
PB3.GPIO_PuPd=GPIO_PULLUP
PB3.Mode=Full_Duplex_Master
PB3.Signal=SPI1_SCK
PB4.GPIO_Label=W5500_MISO
PB4.GPIO_PuPd=GPIO_PULLUP
PB4.Mode=Full_Duplex_Master
PB4.Signal=SPI1_MISO
PB5.GPIO_Label=W5500_MOSI
PB5.GPIO_PuPd=GPIO_PULLUP
PB5.Mode=Full_Duplex_Master
PB5.Signal=SPI1_MOSI
PB6.GPIO_Label=CH4_R
PB6.Signal=GPIO_Output
PB7.GPIO_Label=CH4_G
PB7.Signal=GPIO_Output
PB8.GPIO_Label=MOD_V_Range5
PB8.GPIO_PuPd=GPIO_PULLUP
PB8.Signal=GPIO_Output
PB9.GPIO_Label=MOD_V_Range6
PB9.GPIO_PuPd=GPIO_PULLUP
PB9.Signal=GPIO_Output
PC0.GPIO_Label=AD_Temp17
PC0.Signal=SharedAnalog_PC0
PC1.GPIO_Label=M_Loop5
PC1.GPIO_PuPd=GPIO_PULLDOWN
PC1.Signal=GPIO_Output
PC10.GPIO_Label=AD7175_SCK
PC10.GPIO_PuPd=GPIO_PULLUP
PC10.Mode=Full_Duplex_Master
PC10.Signal=SPI3_SCK
PC11.GPIO_Label=AD7175_MISO
PC11.GPIO_PuPd=GPIO_PULLUP
PC11.Mode=Full_Duplex_Master
PC11.Signal=SPI3_MISO
PC12.GPIO_Label=AD7175_MOSI
PC12.GPIO_PuPd=GPIO_PULLUP
PC12.Mode=Full_Duplex_Master
PC12.Signal=SPI3_MOSI
PC13.GPIO_Label=MOD_DIR4
PC13.GPIO_PuPd=GPIO_PULLUP
PC13.Signal=GPIO_Output
PC2.GPIO_Label=AD_Temp28
PC2.Signal=SharedAnalog_PC2
PC3.GPIO_Label=AD_Aux
PC3.Signal=SharedAnalog_PC3
PC4.GPIO_Label=CH7_R
PC4.Signal=GPIO_Output
PC5.GPIO_Label=CH6_R
PC5.Signal=GPIO_Output
PC6.GPIO_Label=MOD_REV3
PC6.PinState=GPIO_PIN_SET
PC6.Signal=GPIO_Output
PC7.GPIO_Label=MOD_REV4
PC7.PinState=GPIO_PIN_SET
PC7.Signal=GPIO_Output
PC8.GPIO_Label=MOD_REV5
PC8.PinState=GPIO_PIN_SET
PC8.Signal=GPIO_Output
PC9.GPIO_Label=MOD_REV6
PC9.PinState=GPIO_PIN_SET
PC9.Signal=GPIO_Output
PD0.GPIO_Label=AD7175_CS
PD0.GPIO_ModeDefaultOutputPP=GPIO_MODE_OUTPUT_PP
PD0.GPIO_PuPd=GPIO_PULLUP
PD0.GPIO_Speed=GPIO_SPEED_FREQ_HIGH
PD0.PinState=GPIO_PIN_SET
PD0.Signal=GPIO_Output
PD1.GPIO_Label=AD7175_ERR
PD1.Signal=GPIO_Input
PD10.GPIO_Label=MOD_EN6
PD10.GPIO_PuPd=GPIO_PULLDOWN
PD10.PinState=GPIO_PIN_RESET
PD10.Signal=GPIO_Output
PD11.GPIO_Label=MOD_EN7
PD11.GPIO_PuPd=GPIO_PULLDOWN
PD11.PinState=GPIO_PIN_RESET
PD11.Signal=GPIO_Output
PD12.GPIO_Label=MOD_EN8
PD12.GPIO_PuPd=GPIO_PULLDOWN
PD12.PinState=GPIO_PIN_RESET
PD12.Signal=GPIO_Output
PD13.GPIO_Label=MOD_MS1
PD13.Signal=GPIO_Output
PD14.GPIO_Label=MOD_MS2
PD14.GPIO_PuPd=GPIO_PULLUP
PD14.Signal=GPIO_Output
PD15.GPIO_Label=MOD_MS3
PD15.GPIO_PuPd=GPIO_PULLUP
PD15.Signal=GPIO_Output
PD2.GPIO_Label=RUN_R
PD2.GPIO_PuPd=GPIO_NOPULL
PD2.Signal=GPIO_Output
PD3.GPIO_Label=RUN_G
PD3.GPIO_PuPd=GPIO_NOPULL
PD3.Signal=GPIO_Output
PD4.GPIO_Label=CH1_R
PD4.Signal=GPIO_Output
PD5.GPIO_Label=CH1_G
PD5.Signal=GPIO_Output
PD6.GPIO_Label=CH2_G
PD6.Signal=GPIO_Output
PD7.GPIO_Label=CH2_R
PD7.Signal=GPIO_Output
PD8.GPIO_Label=DeBug_TX3
PD8.Mode=Asynchronous
PD8.Signal=USART3_TX
PD9.GPIO_Label=DeBug_RX3
PD9.Mode=Asynchronous
PD9.Signal=USART3_RX
PE0.GPIO_Label=AD7175_RDY
PE0.GPIO_ModeDefaultEXTI=GPIO_MODE_IT_FALLING
PE0.Signal=GPXTI0
PE1.GPIO_Label=AD7124_RDY
PE1.GPIO_ModeDefaultEXTI=GPIO_MODE_IT_FALLING
PE1.Signal=GPXTI1
PE10.GPIO_Label=ADD_4
PE10.GPIO_PuPd=GPIO_PULLDOWN
PE10.Signal=GPIO_Input
PE11.GPIO_Label=DAC1_CS
PE11.GPIO_ModeDefaultOutputPP=GPIO_MODE_OUTPUT_PP
PE11.GPIO_PuPd=GPIO_PULLUP
PE11.GPIO_Speed=GPIO_SPEED_FREQ_HIGH
PE11.PinState=GPIO_PIN_SET
PE11.Signal=GPIO_Output
PE12.GPIO_Label=DAC1_SCK
PE12.GPIO_PuPd=GPIO_PULLUP
PE12.Mode=Full_Duplex_Master
PE12.Signal=SPI4_SCK
PE13.GPIO_Label=DAC1_MISO
PE13.GPIO_PuPd=GPIO_PULLUP
PE13.Mode=Full_Duplex_Master
PE13.Signal=SPI4_MISO
PE14.GPIO_Label=DAC1_MOSI
PE14.GPIO_PuPd=GPIO_PULLUP
PE14.Mode=Full_Duplex_Master
PE14.Signal=SPI4_MOSI
PE15.GPIO_Label=ADD_3
PE15.GPIO_PuPd=GPIO_PULLDOWN
PE15.Signal=GPIO_Input
PE2.GPIO_Label=M_Loop4
PE2.GPIO_PuPd=GPIO_PULLDOWN
PE2.Signal=GPIO_Output
PE3.GPIO_Label=LED2
PE3.PinState=GPIO_PIN_SET
PE3.Signal=GPIO_Output
PE4.GPIO_Label=LED3
PE4.PinState=GPIO_PIN_SET
PE4.Signal=GPIO_Output
PE5.GPIO_Label=MOD_DIR1
PE5.GPIO_PuPd=GPIO_PULLUP
PE5.Signal=GPIO_Output
PE6.GPIO_Label=MOD_DIR2
PE6.GPIO_PuPd=GPIO_PULLUP
PE6.Signal=GPIO_Output
PE7.GPIO_Label=ADD_7
PE7.GPIO_PuPd=GPIO_PULLDOWN
PE7.Signal=GPIO_Input
PE8.GPIO_Label=ADD_6
PE8.GPIO_PuPd=GPIO_PULLDOWN
PE8.Signal=GPIO_Input
PE9.GPIO_Label=ADD_5
PE9.GPIO_PuPd=GPIO_PULLDOWN
PE9.Signal=GPIO_Input
PF0.GPIO_Label=MOD_DIR6
PF0.GPIO_PuPd=GPIO_PULLUP
PF0.Signal=GPIO_Output
PF1.GPIO_Label=MOD_DIR7
PF1.GPIO_PuPd=GPIO_PULLUP
PF1.Signal=GPIO_Output
PF10.GPIO_Label=DAC2_CS
PF10.GPIO_PuPd=GPIO_PULLUP
PF10.GPIO_Speed=GPIO_SPEED_FREQ_HIGH
PF10.PinState=GPIO_PIN_SET
PF10.Signal=GPIO_Output
PF11.GPIO_Label=MOD_PG6
PF11.Signal=GPIO_Input
PF12.GPIO_Label=MOD_PG5
PF12.Signal=GPIO_Input
PF13.GPIO_Label=MOD_PG4
PF13.Signal=GPIO_Input
PF14.GPIO_Label=MOD_PG3
PF14.Signal=GPIO_Input
PF15.GPIO_Label=MOD_PG2
PF15.Signal=GPIO_Input
PF2.GPIO_Label=MOD_DIR8
PF2.GPIO_PuPd=GPIO_PULLUP
PF2.Signal=GPIO_Output
PF3.GPIO_Label=AD_Bus1
PF3.Signal=SharedAnalog_PF3
PF4.GPIO_Label=AD_Bus2
PF4.Signal=SharedAnalog_PF4
PF5.GPIO_Label=AD_Vmod17
PF5.Signal=SharedAnalog_PF5
PF6.GPIO_Label=AD_Vmod28
PF6.Signal=SharedAnalog_PF6
PF7.GPIO_Label=DAC2_SCK
PF7.GPIO_PuPd=GPIO_PULLUP
PF7.Mode=Full_Duplex_Master
PF7.Signal=SPI5_SCK
PF8.GPIO_Label=DAC2_MISO
PF8.GPIO_PuPd=GPIO_PULLUP
PF8.Mode=Full_Duplex_Master
PF8.Signal=SPI5_MISO
PF9.GPIO_Label=DAC2_MOSI
PF9.GPIO_PuPd=GPIO_PULLUP
PF9.Mode=Full_Duplex_Master
PF9.Signal=SPI5_MOSI
PG0.GPIO_Label=MOD_PG1
PG0.Signal=GPIO_Input
PG1.GPIO_Label=ADD_8
PG1.GPIO_PuPd=GPIO_PULLDOWN
PG1.Signal=GPIO_Input
PG10.GPIO_Label=CH3_R
PG10.Signal=GPIO_Output
PG11.GPIO_Label=FRAM_CS
PG11.GPIO_ModeDefaultOutputPP=GPIO_MODE_OUTPUT_PP
PG11.GPIO_PuPd=GPIO_PULLUP
PG11.GPIO_Speed=GPIO_SPEED_FREQ_HIGH
PG11.PinState=GPIO_PIN_SET
PG11.Signal=GPIO_Output
PG12.GPIO_Label=FRAM_MISO
PG12.GPIO_PuPd=GPIO_PULLUP
PG12.Mode=Full_Duplex_Master
PG12.Signal=SPI6_MISO
PG13.GPIO_Label=FRAM_SCK
PG13.GPIO_PuPd=GPIO_PULLUP
PG13.Mode=Full_Duplex_Master
PG13.Signal=SPI6_SCK
PG14.GPIO_Label=FRAM_MOSI
PG14.GPIO_PuPd=GPIO_PULLUP
PG14.Mode=Full_Duplex_Master
PG14.Signal=SPI6_MOSI
PG15.GPIO_Label=MOD_V_Range4
PG15.GPIO_PuPd=GPIO_PULLUP
PG15.Signal=GPIO_Output
PG2.GPIO_Label=MOD_MS4
PG2.GPIO_PuPd=GPIO_PULLUP
PG2.Signal=GPIO_Output
PG3.GPIO_Label=MOD_MS5
PG3.GPIO_PuPd=GPIO_PULLUP
PG3.Signal=GPIO_Output
PG4.GPIO_Label=MOD_MS6
PG4.GPIO_PuPd=GPIO_PULLUP
PG4.Signal=GPIO_Output
PG5.GPIO_Label=MOD_MS7
PG5.GPIO_PuPd=GPIO_PULLUP
PG5.Signal=GPIO_Output
PG6.GPIO_Label=MOD_MS8
PG6.GPIO_PuPd=GPIO_PULLUP
PG6.Signal=GPIO_Output
PG7.GPIO_Label=MOD_REV1
PG7.PinState=GPIO_PIN_SET
PG7.Signal=GPIO_Output
PG8.GPIO_Label=MOD_REV2
PG8.PinState=GPIO_PIN_SET
PG8.Signal=GPIO_Output
PG9.GPIO_Label=CH3_G
PG9.Signal=GPIO_Output
PH0/OSC_IN.Mode=HSE-External-Oscillator
PH0/OSC_IN.Signal=RCC_OSC_IN
PH1/OSC_OUT.Mode=HSE-External-Oscillator
PH1/OSC_OUT.Signal=RCC_OSC_OUT
PH10.GPIO_Label=MOD_EN2
PH10.GPIO_PuPd=GPIO_PULLDOWN
PH10.PinState=GPIO_PIN_RESET
PH10.Signal=GPIO_Output
PH11.GPIO_Label=MOD_EN3
PH11.GPIO_PuPd=GPIO_PULLDOWN
PH11.PinState=GPIO_PIN_RESET
PH11.Signal=GPIO_Output
PH12.GPIO_Label=MOD_EN4
PH12.GPIO_PuPd=GPIO_PULLDOWN
PH12.PinState=GPIO_PIN_RESET
PH12.Signal=GPIO_Output
PH13.GPIO_Label=MOD_V_Range1
PH13.GPIO_PuPd=GPIO_PULLUP
PH13.Signal=GPIO_Output
PH14.GPIO_Label=MOD_V_Range2
PH14.GPIO_PuPd=GPIO_PULLUP
PH14.Signal=GPIO_Output
PH15.GPIO_Label=MOD_V_Range3
PH15.GPIO_PuPd=GPIO_PULLUP
PH15.Signal=GPIO_Output
PH2.GPIO_Label=SNA
PH2.GPIO_PuPd=GPIO_NOPULL
PH2.GPIO_Speed=GPIO_SPEED_FREQ_HIGH
PH2.PinState=GPIO_PIN_SET
PH2.Signal=GPIO_Output
PH3.GPIO_Label=SNB
PH3.GPIO_PuPd=GPIO_NOPULL
PH3.GPIO_Speed=GPIO_SPEED_FREQ_HIGH
PH3.PinState=GPIO_PIN_SET
PH3.Signal=GPIO_Output
PH4.GPIO_Label=AD5245_SDA
PH4.GPIO_PuPd=GPIO_PULLUP
PH4.GPIO_Speed=GPIO_SPEED_FREQ_HIGH
PH4.PinState=GPIO_PIN_SET
PH4.Signal=GPIO_Output
PH5.GPIO_Label=AD5245_SCL
PH5.GPIO_PuPd=GPIO_PULLUP
PH5.GPIO_Speed=GPIO_SPEED_FREQ_HIGH
PH5.PinState=GPIO_PIN_SET
PH5.Signal=GPIO_Output
PH6.GPIO_Label=ADD_1
PH6.GPIO_PuPd=GPIO_PULLDOWN
PH6.Signal=GPIO_Input
PH7.GPIO_Label=EE_SCL
PH7.GPIO_ModeDefaultOutputPP=GPIO_MODE_OUTPUT_PP
PH7.GPIO_PuPd=GPIO_PULLUP
PH7.GPIO_Speed=GPIO_SPEED_FREQ_HIGH
PH7.PinState=GPIO_PIN_SET
PH7.Signal=GPIO_Output
PH8.GPIO_Label=EE_SDA
PH8.GPIO_PuPd=GPIO_PULLUP
PH8.GPIO_Speed=GPIO_SPEED_FREQ_HIGH
PH8.PinState=GPIO_PIN_SET
PH8.Signal=GPIO_Output
PH9.GPIO_Label=MOD_EN1
PH9.GPIO_PuPd=GPIO_PULLDOWN
PH9.PinState=GPIO_PIN_RESET
PH9.Signal=GPIO_Output
PI0.GPIO_Label=AD7124_CS
PI0.GPIO_PuPd=GPIO_PULLUP
PI0.GPIO_Speed=GPIO_SPEED_FREQ_HIGH
PI0.PinState=GPIO_PIN_SET
PI0.Signal=GPIO_Output
PI1.GPIO_Label=AD7124_SCK
PI1.GPIO_PuPd=GPIO_PULLUP
PI1.Mode=Full_Duplex_Master
PI1.Signal=SPI2_SCK
PI10.GPIO_Label=M_Loop6
PI10.GPIO_PuPd=GPIO_PULLDOWN
PI10.Signal=GPIO_Output
PI11.GPIO_Label=M_Loop3
PI11.GPIO_PuPd=GPIO_PULLDOWN
PI11.Signal=GPIO_Output
PI2.GPIO_Label=AD7124_MISO
PI2.GPIO_PuPd=GPIO_PULLUP
PI2.Mode=Full_Duplex_Master
PI2.Signal=SPI2_MISO
PI3.GPIO_Label=AD7124_MOSI
PI3.GPIO_PuPd=GPIO_PULLUP
PI3.Mode=Full_Duplex_Master
PI3.Signal=SPI2_MOSI
PI4.GPIO_Label=MOD_V_Range7
PI4.GPIO_PuPd=GPIO_PULLUP
PI4.Signal=GPIO_Output
PI5.GPIO_Label=MOD_V_Range8
PI5.GPIO_PuPd=GPIO_PULLUP
PI5.Signal=GPIO_Output
PI6.GPIO_Label=W5500_CS
PI6.GPIO_PuPd=GPIO_PULLUP
PI6.GPIO_Speed=GPIO_SPEED_FREQ_HIGH
PI6.PinState=GPIO_PIN_SET
PI6.Signal=GPIO_Output
PI7.GPIO_Label=W5500_RST
PI7.GPIO_PuPd=GPIO_PULLUP
PI7.GPIO_Speed=GPIO_SPEED_FREQ_HIGH
PI7.PinState=GPIO_PIN_SET
PI7.Signal=GPIO_Output
PI8.GPIO_Label=MOD_DIR3
PI8.GPIO_PuPd=GPIO_PULLUP
PI8.Signal=GPIO_Output
PI9.GPIO_Label=MOD_DIR5
PI9.GPIO_PuPd=GPIO_PULLUP
PI9.Signal=GPIO_Output
ProjectManager.HeapSize=0x200
ProjectManager.StackSize=0x400
ProjectManager.TargetToolchain=MDK-ARM V5.27
RCC.48MHZClocksFreq_Value=90000000
RCC.AHBFreq_Value=180000000
RCC.APB1CLKDivider=RCC_HCLK_DIV4
RCC.APB1Freq_Value=45000000
RCC.APB1TimFreq_Value=90000000
RCC.APB2CLKDivider=RCC_HCLK_DIV2
RCC.APB2Freq_Value=90000000
RCC.APB2TimFreq_Value=180000000
RCC.CortexFreq_Value=180000000
RCC.HCLKFreq_Value=180000000
RCC.HSE_VALUE=8000000
RCC.HSI_VALUE=16000000
RCC.LSE_VALUE=32768
RCC.PLLM=4
RCC.PLLN=180
RCC.PLLSourceVirtual=RCC_PLLSOURCE_HSE
RCC.SYSCLKFreq_VALUE=180000000
RCC.SYSCLKSource=RCC_SYSCLKSOURCE_PLLCLK
RCC.VCOOutputFreq_Value=360000000
SH.SharedAnalog_PA3.0=GPIO_Analog
SH.SharedAnalog_PA3.1=ADC3_IN3,IN3
SH.SharedAnalog_PC0.0=GPIO_Analog
SH.SharedAnalog_PC0.1=ADC3_IN10,IN10
SH.SharedAnalog_PC2.0=GPIO_Analog
SH.SharedAnalog_PC2.1=ADC3_IN12,IN12
SH.SharedAnalog_PC3.0=GPIO_Analog
SH.SharedAnalog_PC3.1=ADC3_IN13,IN13
SH.SharedAnalog_PF3.0=GPIO_Analog
SH.SharedAnalog_PF3.1=ADC3_IN9,IN9
SH.SharedAnalog_PF4.0=GPIO_Analog
SH.SharedAnalog_PF4.1=ADC3_IN14,IN14
SH.SharedAnalog_PF5.0=GPIO_Analog
SH.SharedAnalog_PF5.1=ADC3_IN15,IN15
SH.SharedAnalog_PF6.0=GPIO_Analog
SH.SharedAnalog_PF6.1=ADC3_IN4,IN4
SPI1.CalculateBaudRate=45.0 MBits/s
SPI1.Direction=SPI_DIRECTION_2LINES
SPI1.Mode=SPI_MODE_MASTER
SPI1.VirtualType=VM_MASTER
SPI2.BaudRatePrescaler=SPI_BAUDRATEPRESCALER_16
SPI2.CalculateBaudRate=2.8125 MBits/s
SPI2.Direction=SPI_DIRECTION_2LINES
SPI2.Mode=SPI_MODE_MASTER
SPI2.VirtualType=VM_MASTER
SPI3.BaudRatePrescaler=SPI_BAUDRATEPRESCALER_4
SPI3.CalculateBaudRate=11.25 MBits/s
SPI3.Direction=SPI_DIRECTION_2LINES
SPI3.Mode=SPI_MODE_MASTER
SPI3.VirtualType=VM_MASTER
SPI4.BaudRatePrescaler=SPI_BAUDRATEPRESCALER_8
SPI4.CLKPolarity=SPI_POLARITY_HIGH
SPI4.CalculateBaudRate=11.25 MBits/s
SPI4.Direction=SPI_DIRECTION_2LINES
SPI4.Mode=SPI_MODE_MASTER
SPI4.VirtualType=VM_MASTER
SPI5.BaudRatePrescaler=SPI_BAUDRATEPRESCALER_8
SPI5.CLKPolarity=SPI_POLARITY_HIGH
SPI5.CalculateBaudRate=11.25 MBits/s
SPI5.Direction=SPI_DIRECTION_2LINES
SPI5.Mode=SPI_MODE_MASTER
SPI5.VirtualType=VM_MASTER
SPI6.BaudRatePrescaler=SPI_BAUDRATEPRESCALER_4
SPI6.CLKPhase=SPI_PHASE_2EDGE
SPI6.CLKPolarity=SPI_POLARITY_HIGH
SPI6.CalculateBaudRate=22.5 MBits/s
SPI6.Direction=SPI_DIRECTION_2LINES
SPI6.Mode=SPI_MODE_MASTER
SPI6.VirtualType=VM_MASTER
TIM4.AutoReloadPreload=TIM_AUTORELOAD_PRELOAD_ENABLE
TIM4.ClockDivision=TIM_CLOCKDIVISION_DIV2
TIM4.Period=44999
USART3.VirtualMode=VM_ASYNC
VP_IWDG_VS_IWDG.Mode=IWDG_Activate
VP_SYS_VS_tim7.Mode=TIM7
VP_TIM4_VS_ClockSourceINT.Mode=Internal
board=custom

// file: Core/Src/main.c
/* USER CODE BEGIN Header */
/**
  ******************************************************************************
  * @file           : main.c
  * @brief          : Main program body
  ******************************************************************************
  * @attention
  *
  * <h2><center>&copy; Copyright (c) 2021 STMicroelectronics.
  * All rights reserved.</center></h2>
  *
  * This software component is licensed by ST under BSD 3-Clause license,
  * the "License"; You may not use this file except in compliance with the
  * License. You may obtain a copy of the License at:
  *                        opensource.org/licenses/BSD-3-Clause
  *
  ******************************************************************************
  */
/* USER CODE END Header */
#include "main.h"
#include "adc.h"
#include "can.h"
#include "iwdg.h"
#include "spi.h"
#include "tim.h"
#include "usart.h"
#include "gpio.h"

/* USER CODE BEGIN Includes */
#include "bsp_dwt.h"
#include "bsp_eeprom.h"
#include "bsp_gpio.h"
#include "bsp_charge.h"
#include "string.h"
#include "wizchip_conf.h"
#include "w5500.h"
#include "w5500socket.h"
#include "stdio.h"
#include "bsp_tcp.h"
/* USER CODE END Includes */

/* USER CODE BEGIN PTD */

/**********************************************************************************************************
**                                           类型定义区
**********************************************************************************************************/
typedef  void (*pFunction)(void);
typedef struct
{
    uint8_t g_ucDatBuff[1000];
    uint16_t rcv_len;
} rcv_Struct;

/* USER CODE END PTD */

/* USER CODE BEGIN PV */
/**********************************************************************************************************
**                                         全局变量定义区
**********************************************************************************************************/
wiz_NetInfo NetConf =                                       /*W5500网络配置*/
{
    {0x00, 0x28, 0xf4, 0x00, 0x00, 0x00}, // mac默认地址,后3位表示2021年10月生产，流水号0
    {192, 168, 1, 11},                    // 本地IP地址
    {255, 255, 0, 0},                     // 子网掩码
    {192, 168, 1, 1},                     // 网关地址
    {0, 0, 0, 0},                         // DNS服务器地址
    NETINFO_STATIC                        // 使用静态IP
};

uint8_t txbuf_size[8] = {16, 0, 0, 0, 0, 0, 0, 0};    // W5500发送缓存区分配数组，有效分配值范围：{1,2,4,8,16}
uint8_t rxbuf_size[8] = {16, 0, 0, 0, 0, 0, 0, 0};    // w5500接受缓存区分配数组
uint8_t MAC_ID[3]={0}; //MAC条码信息位，前10bit表示年月（2021-10起始，按月累加），后14bit表示流水号

pFunction Jump_To_Application;
uint32_t JumpAddress;
rcv_Struct w5500_rcvbuf;

/* USER CODE END PV */

void SystemClock_Config(void);

/* USER CODE BEGIN 0 */
/**********************************************************************************************************
**                                           应用函数区
**********************************************************************************************************/

/*
*********************************************************************************************************
*   函 数 名: W5500_init
*   功能说明: W5500初始化函数
*   形    参: 无
*   返 回 值: 无
*********************************************************************************************************
*/
void W5500_init(void)
{
    /*配置接口注册函数*/
    reg_wizchip_cris_cbfunc(NULL, NULL);     //不注册自定义临界进出函数，使用默认函数，功能已改写
    reg_wizchip_cs_cbfunc(NULL, NULL);       //不注册自定义片选函数，使用默认函数，功能已改写
    reg_wizchip_spi_cbfunc(NULL, NULL);       //不注册自定义SPI单字节收发函数，使用默认函数，功能已改写,使用SPI1
    //reg_wizchip_spiburst_cbfunc(NULL,NULL);    //不注册自定义SPI块字节收发函数，使用默认函数，功能已改写
    /*检查网线链接*/
    uint8_t PHY_connect = 0; //网线连接状态
    uint16_t CNT = 0;
    while(PHY_connect == 0)
    {
        PHY_connect = 0x01 & IINCHIP_READ(PHYCFGR);
        HAL_Delay(1);
        Feed_WDG();       //喂狗
        if(++CNT > 5000) //尝试5000次(5S)，若网线未连接跳出
        {
            //           printf("网线未连接!\n\n");
            break;
        }
    }

    /*硬件复位*/
    //HAL_GPIO_WritePin(W5500_RST_GPIO_Port, W5500_RST_Pin, GPIO_PIN_SET);
    //HAL_GPIO_WritePin(W5500_RST_GPIO_Port, W5500_RST_Pin, GPIO_PIN_RESET);
    //bsp_DelayMS(1);
    //HAL_GPIO_WritePin(W5500_RST_GPIO_Port, W5500_RST_Pin, GPIO_PIN_SET);

    /*软件复位（复位内部寄存器）*/
    wizchip_sw_reset();
    bsp_DelayMS(1);
    /*配置MAC，IP*/
    wiz_NetInfo conf;                                               // 用于存储回读网络参数
    ctlnetwork(CN_SET_NETINFO, (void *) &NetConf);                  // 配置网络参数
    ctlnetwork(CN_GET_NETINFO, (void *) &conf);                     // 回读
    if(memcmp(&conf, &NetConf, sizeof(wiz_NetInfo)) == 0)
    {
        //        printf("W5500网络参数配置成功!\n\n");      // 配置成功
    }
    else
    {
        //        printf("W5500网络参数配置失败!\n\n");      // 配置失败
    }
    /*设置socket收发缓存区大小*/
    wizchip_init(txbuf_size,  rxbuf_size);
    /*设置最大重发次数，超时时间*/
    wiz_NetTimeout to;
    to.retry_cnt = 8;     // 重试次数，默认8次
    to.time_100us = 2000; // 超时时间，默认2000*100us = 200ms
    wizchip_settimeout(&to);
}

/*
*********************************************************************************************************
*   函 数 名: Boot_JMP_APP
*   功能说明: 跳转到APP
*   形    参: 无
*   返 回 值: 无
*********************************************************************************************************
*/
void Boot_JMP_APP(void)
{
    __set_PRIMASK(1)    /* 禁止全局中断 */;
    if(((*(__IO uint32_t *)APPLICATION_ADDRESS) & 0x2FFE0000) == 0x20000000) //地址是否合法
    {
        /* Jump to user application */
        JumpAddress = *(__IO uint32_t *)(APPLICATION_ADDRESS + 4);
        Jump_To_Application = (pFunction) JumpAddress;
        /* Initialize user application's Stack Pointer */
        __set_MSP(*(__IO uint32_t *) APPLICATION_ADDRESS);
        Jump_To_Application();
    }
}

/*
*********************************************************************************************************
*   函 数 名: Loop_En_Init
*   功能说明: 初始化LOOP和EN脚
*   形    参: 无
*   返 回 值: 无
*********************************************************************************************************
*/
void Loop_En_Init(void)
{
    HAL_GPIO_WritePin(M_Loop1_GPIO_Port, M_Loop1_Pin, GPIO_PIN_RESET);
    HAL_GPIO_WritePin(M_Loop2_GPIO_Port, M_Loop2_Pin, GPIO_PIN_RESET);
    HAL_GPIO_WritePin(M_Loop3_GPIO_Port, M_Loop3_Pin, GPIO_PIN_RESET);
    HAL_GPIO_WritePin(M_Loop4_GPIO_Port, M_Loop4_Pin, GPIO_PIN_RESET);
    HAL_GPIO_WritePin(M_Loop5_GPIO_Port, M_Loop5_Pin, GPIO_PIN_RESET);
    HAL_GPIO_WritePin(M_Loop6_GPIO_Port, M_Loop6_Pin, GPIO_PIN_RESET);
    HAL_GPIO_WritePin(M_Loop7_GPIO_Port, M_Loop7_Pin, GPIO_PIN_RESET);
    HAL_GPIO_WritePin(M_Loop8_GPIO_Port, M_Loop8_Pin, GPIO_PIN_RESET);

    HAL_GPIO_WritePin(MOD_EN1_GPIO_Port, MOD_EN1_Pin, GPIO_PIN_RESET);
    HAL_GPIO_WritePin(MOD_EN2_GPIO_Port, MOD_EN2_Pin, GPIO_PIN_RESET);
    HAL_GPIO_WritePin(MOD_EN3_GPIO_Port, MOD_EN3_Pin, GPIO_PIN_RESET);
    HAL_GPIO_WritePin(MOD_EN4_GPIO_Port, MOD_EN4_Pin, GPIO_PIN_RESET);
    HAL_GPIO_WritePin(MOD_EN5_GPIO_Port, MOD_EN5_Pin, GPIO_PIN_RESET);
    HAL_GPIO_WritePin(MOD_EN6_GPIO_Port, MOD_EN6_Pin, GPIO_PIN_RESET);
    HAL_GPIO_WritePin(MOD_EN7_GPIO_Port, MOD_EN7_Pin, GPIO_PIN_RESET);
    HAL_GPIO_WritePin(MOD_EN8_GPIO_Port, MOD_EN8_Pin, GPIO_PIN_RESET);
}

/**********************************************************************************************************
**  函 数 名 : BarCode_Mac_CheckSet()
**  功能说明 : 条码Mac关联一致性检查设置函数，需要操作EE
**  形    参 : 无
**  返 回 值 : 无
**********************************************************************************************************/
uint8_t BarCode_Mac_CheckSet(void)
{
    uint8_t Read_En = 0;
    uint8_t Bar_Code[50] = {0};
    uint8_t Bar_Code_Len = 0;
    uint8_t Pyear, Pmonth; //生产年月
    uint16_t Pid; //流水号
    uint16_t Pym; //年月编码
    uint32_t Pmac = 0; //mac编号(低3字节有效)
    uint8_t err = 0;

    ee_ReadBytes(&Read_En, MacEn_flag_addr , 1);    //读EE，是否使能使用EE内部MAC
    if(Read_En == 1)
    {
        ee_ReadBytes(MAC_ID, MacID_flag_addr , 3);       //读MAC
        ee_ReadBytes(&Bar_Code_Len, BarCode_Len_flag_addr , 1);  //读条码长度
        if(Bar_Code_Len < 50)                       //条码字符串长度限制50字节
        {
            ee_ReadBytes(Bar_Code, BarCode_End_flag_addr - Bar_Code_Len + 1, Bar_Code_Len);  //根据长度读条码内容

            /*检查数据有效性*/
            if((Bar_Code[0] == 'J') && (Bar_Code[1] == 'N'))            //判读条码头, JN开头
            {
                for(uint8_t i = 0; i < 8; i++)
                {
                    if(Bar_Code[4 + i] > 0x39 || Bar_Code[4 + i] < 0x30) //判断要处理位(年月流水)是否为数字ASC码
                    {
                        err = 1;
                        break;
                    }
                }
            }
            else
            {
                err = 1;
            }
            /*检查关联MAC处理*/
            if(err == 0)
            {
                /*计算年月流水*/
                Pyear = (Bar_Code[4] - 0x30) * 10 + (Bar_Code[5] - 0x30);
                Pmonth = (Bar_Code[6] - 0x30) * 10 + (Bar_Code[7] - 0x30);
                if((Pyear < 21) || (Pmonth > 12) || ((Pyear == 21) && (Pmonth < 10))) //再次判断年月有效范围
                {
                    err = 1;
                }
                if(err == 0)
                {
                    Pid = (Bar_Code[8] - 0x30) * 1000 + (Bar_Code[9] - 0x30) * 100 + (Bar_Code[10] - 0x30) * 10 + (Bar_Code[11] - 0x30); //求流水号
                    Pym = (Pyear == 21) ? (Pmonth - 10) : ((Pyear - 22) * 12 + Pmonth + 2); //求年月编号
                    Pmac = (MAC_ID[0] << 16) + (MAC_ID[1] << 8) + MAC_ID[2]; //求MAC编号
                    if(Pmac != (Pym << 14) + Pid)
                    {
                        err = 1;
                    }
                }
            }
        }
        else
        {
            err = 1;
        }

        if(err)
        {
            MAC_ID[0] = 0;  //使用默认MAC
            MAC_ID[1] = 0;
            MAC_ID[2] = 0;
        }
    }
    return err;
}

/* USER CODE END 0 */

int main(void)
{
  /* USER CODE BEGIN 1 */
    uint8_t Bootflg1;      //boot标志位1
    uint8_t Bootflg2;      //boot标志位2
  /* USER CODE END 1 */

  /* MCU Configuration--------------------------------------------------------*/

  /* Reset of all peripherals, Initializes the Flash interface and the Systick. */
  HAL_Init();

  /* Configure the system clock */
  SystemClock_Config();

  /* Initialize all configured peripherals */
  MX_GPIO_Init();
  MX_SPI1_Init();
  MX_IWDG_Init();
  MX_TIM4_Init();
  MX_ADC3_Init();
  MX_CAN1_Init();
  MX_CAN2_Init();
  MX_SPI2_Init();
  MX_SPI3_Init();
  MX_SPI4_Init();
  MX_SPI5_Init();
  MX_SPI6_Init();
  MX_USART3_UART_Init();
  /* USER CODE BEGIN 2 */
    bsp_InitDWT();
    Loop_En_Init();                  //初始化LOOP，EN脚电平
    __HAL_SPI_ENABLE(&hspi1);        //使能SPI1
    __HAL_TIM_ENABLE(&htim4);        //使能TIM4
    bsp_InitI2C();                   //初始化EE接口

    IP_Scanning();                   //扫描拨码，获取本地IP后2位
    NetConf.ip[2] = W5500_IP_ADDRESS[2];
    NetConf.ip[3] = W5500_IP_ADDRESS[3];

#if 1
    BarCode_Mac_CheckSet(); //检查条码MAC一致性，设置MAC
    NetConf.mac[3]=MAC_ID[0];
    NetConf.mac[4]=MAC_ID[1];
    NetConf.mac[5]=MAC_ID[2];
#else
    NetConf.mac[2]=NetConf.ip[0];    //mac后4位用IP表示
    NetConf.mac[3]=NetConf.ip[1];
    NetConf.mac[4]=NetConf.ip[2];
    NetConf.mac[5]=NetConf.ip[3];
#endif
    W5500_init();                    //W5500初始化

    HAL_TIM_Base_Start_IT(&htim4);   //使用定时器的时候调用这个函数启动
    HAL_NVIC_EnableIRQ(TIM4_IRQn);

    /*APP跳转判断逻辑*/
    Feed_WDG();
    ee_ReadBytes(&Bootflg1, BOOT1_addr, 1);
    ee_ReadBytes(&Bootflg2, BOOT2_addr , 1);

#if 1

    if(((Bootflg1 == 0xAA) && (Bootflg2 == 0x55)) || \
            ((Bootflg1 == 0xFF) && (Bootflg2 == 0xFF)))
    {
        Feed_WDG();
        HAL_NVIC_DisableIRQ(EXTI0_IRQn);
        HAL_NVIC_DisableIRQ(EXTI1_IRQn);
        HAL_NVIC_DisableIRQ(TIM4_IRQn);     //跳转前关单个中断，防止APP未使用该中断时再次开启总中断后找不到入口
        DISABLE_INT();                      //关总中断
        Boot_JMP_APP();
    }
    else
        if((Bootflg1 == 0xA0) && (Bootflg2 == 0x50))
        {
            Bootflg1 = 0xff;
            Bootflg2 = 0xff;
            ee_WriteBytes(&Bootflg1, BOOT1_addr, 1);
            bsp_DelayMS(1);
            ee_WriteBytes(&Bootflg2, BOOT2_addr, 1);
            bsp_DelayMS(1);
            Feed_WDG();
            HAL_NVIC_DisableIRQ(EXTI0_IRQn);
            HAL_NVIC_DisableIRQ(EXTI1_IRQn);
            HAL_NVIC_DisableIRQ(TIM4_IRQn);   //跳转前关单个中断，防止APP未使用该中断时再次开启总中断后找不到入口
            DISABLE_INT();                    //关总中断
            Boot_JMP_APP();
        }

#endif
    //HAL_GPIO_WritePin(EN_245D_GPIO_Port, EN_245D_Pin, GPIO_PIN_RESET); //使能245D（仅G版硬件需要，H版不需要）

  /* USER CODE END 2 */

  /* Infinite loop */
  /* USER CODE BEGIN WHILE */
    while(1)
    {
        uint16_t Loop_cnt;
    /* USER CODE END WHILE */

    /* USER CODE BEGIN 3 */
        W5500_TCP_Server();
        Socket_Receive();
        TCP_RX_Data_Analysis();
        Feed_WDG();       //喂狗
        HAL_Delay(1);
        Loop_cnt++;
        if(Loop_cnt >= 500)
        {
            Loop_cnt = 0;
            HAL_GPIO_TogglePin(LED3_GPIO_Port, LED3_Pin);
            HAL_GPIO_TogglePin(LED2_GPIO_Port, LED2_Pin);
        }
    }
  /* USER CODE END 3 */
}

void SystemClock_Config(void)
{
  RCC_OscInitTypeDef RCC_OscInitStruct = {0};
  RCC_ClkInitTypeDef RCC_ClkInitStruct = {0};

  /** Configure the main internal regulator output voltage
  */
  __HAL_RCC_PWR_CLK_ENABLE();
  __HAL_PWR_VOLTAGESCALING_CONFIG(PWR_REGULATOR_VOLTAGE_SCALE1);
  /** Initializes the RCC Oscillators according to the specified parameters
  * in the RCC_OscInitTypeDef structure.
  */
  RCC_OscInitStruct.OscillatorType = RCC_OSCILLATORTYPE_LSI|RCC_OSCILLATORTYPE_HSE;
  RCC_OscInitStruct.HSEState = RCC_HSE_ON;
  RCC_OscInitStruct.LSIState = RCC_LSI_ON;
  RCC_OscInitStruct.PLL.PLLState = RCC_PLL_ON;
  RCC_OscInitStruct.PLL.PLLSource = RCC_PLLSOURCE_HSE;
  RCC_OscInitStruct.PLL.PLLM = 4;
  RCC_OscInitStruct.PLL.PLLN = 180;
  RCC_OscInitStruct.PLL.PLLP = RCC_PLLP_DIV2;
  RCC_OscInitStruct.PLL.PLLQ = 4;
  if (HAL_RCC_OscConfig(&RCC_OscInitStruct) != HAL_OK)
  {
    Error_Handler();
  }
  /** Activate the Over-Drive mode
  */
  if (HAL_PWREx_EnableOverDrive() != HAL_OK)
  {
    Error_Handler();
  }
  /** Initializes the CPU, AHB and APB buses clocks
  */
  RCC_ClkInitStruct.ClockType = RCC_CLOCKTYPE_HCLK|RCC_CLOCKTYPE_SYSCLK
                              |RCC_CLOCKTYPE_PCLK1|RCC_CLOCKTYPE_PCLK2;
  RCC_ClkInitStruct.SYSCLKSource = RCC_SYSCLKSOURCE_PLLCLK;
  RCC_ClkInitStruct.AHBCLKDivider = RCC_SYSCLK_DIV1;
  RCC_ClkInitStruct.APB1CLKDivider = RCC_HCLK_DIV4;
  RCC_ClkInitStruct.APB2CLKDivider = RCC_HCLK_DIV2;

  if (HAL_RCC_ClockConfig(&RCC_ClkInitStruct, FLASH_LATENCY_5) != HAL_OK)
  {
    Error_Handler();
  }
}

 /**
  * @brief  Period elapsed callback in non blocking mode
  * @note   This function is called  when TIM7 interrupt took place, inside
  * HAL_TIM_IRQHandler(). It makes a direct call to HAL_IncTick() to increment
  * a global variable "uwTick" used as application time base.
  * @param  htim : TIM handle
  * @retval None
  */
void HAL_TIM_PeriodElapsedCallback(TIM_HandleTypeDef *htim)
{
  if (htim->Instance == TIM7) {
    HAL_IncTick();
  }
}

void Error_Handler(void)
{
    __disable_irq();
    while(1)
    {
    }
}

/************************ (C) COPYRIGHT STMicroelectronics *****END OF FILE****/
