/**********************************************************************************************************
** Company     : JNE WuHan Co.,Ltd.
** Project     :
** --------------------------------------------------------------------------------------------------------
** File name   : bsp_temp.c
** Author      : Huang Cheng
** Date        : 2022-01-06
** Description : bsp_temp source file
**********************************************************************************************************/

/**********************************************************************************************************
ADC通道采样顺序配置为：
TEMP1   :IN10   CH0
TEMP2   :IN11   CH1
TEMP3   :IN0    CH2
TEMP4   :IN1    CH3
TEMP5   :IN2    CH4
TEMP6   :IN3    CH5
TEMP7   :IN12   CH6
TEMP8   :IN13   CH7
AD_TEMP :IN4    CH8
**********************************************************************************************************/

/**********************************************************************************************************
**                                          头文件引用区
**********************************************************************************************************/
#include "adc.h"
#include "dma.h"
#include "bsp_temp.h"
#include <stdio.h>

/**********************************************************************************************************
**                                         全局变量定义区
**********************************************************************************************************/
float TempVal[TEMP_CH_NUM] = {0};
uint16_t TempAdcBuff[TEMP_BUFF_SIZE] = {0};

s_DebugParamStruct DebugInqPara = {0};

/**********************************************************************************************************
**                                           函数声明区
**********************************************************************************************************/
static float Get_NTC_Temperature(float Rntc);

/**********************************************************************************************************
**                                           应用函数区
**********************************************************************************************************/
/**********************************************************************************************************
**	函 数 名 : bsp_TempInit()
**	功能说明 : 温度采集初始化
**	形    参 : 无
**	返 回 值 : 无
**********************************************************************************************************/
void bsp_TempInit(void)
{
	MX_ADC1_Init();
	
	//开启ADC触发DMA循环传输
	if(HAL_ADC_Start_DMA(&hadc1,(uint32_t*)TempAdcBuff, TEMP_BUFF_SIZE)!= HAL_OK)
	{        
		Error_Handler();
	}
}

/**********************************************************************************************************
**	函 数 名 : Get_NTC_Temperature
**	功能说明 : 获取NTC 温度,摄氏度,
**	形    参 : Rntc---NTC当前温度的阻值
**	返 回 值 : 摄氏温度，浮点型
**********************************************************************************************************/
static float Get_NTC_Temperature(float Rntc)
{
	float N1, N2, N3, N4, lnR25, lnRntc;
	
	lnR25 = log(R25);          //ln(5000);
	lnRntc = log(Rntc);        //ln(Rntc);
	N1 = (lnR25-lnRntc) / B;
	N2 = (1.0/T25) - N1;
	N3 = 1.0 / N2;
	N4 = N3 - T0;
	
	return N4;
}

/**********************************************************************************************************
**	函 数 名 : GetTempVal()
**	功能说明 : 获取温度ADC值
**	形    参 : 无
**	返 回 值 : 无
**********************************************************************************************************/
void GetTempVal(void)
{
	float NTC_R = 0.0;
	float Temp_Vadc = 0.0;
	float TempFilterAdc[TEMP_CH_NUM] = {0};
	
	/* 获取20次累加的ADC值 */
	for(uint8_t i = 0; i < TEMP_FILTER_NUM; i++)
	{
		for(uint8_t j = 0; j < TEMP_CH_NUM; j++)
		{
			TempFilterAdc[j] += TempAdcBuff[j+i*TEMP_CH_NUM];
		}
	}
	
	
	/* 获取20次滤波后的ADC值并计算温度值 */
	for(uint8_t k = 0; k < TEMP_CH_NUM; k++)
	{
		TempFilterAdc[k] /= TEMP_FILTER_NUM;
		
		if(k == (TEMP_CH_NUM-1))
		{
			//控制板温度
			TempVal[k] = (((TempFilterAdc[k]/ADC_REF_VAL)*ADC_REF_VOL/1.5)-TMP235_OFFSET_VOL) / VOL_PER_TEMP; //T = (Vadc-0.5) / 0.01
			DebugInqPara.Ro.Tcb = TempVal[k];
		}
		else
		{
			//功率板温度
			Temp_Vadc = (TempFilterAdc[k]/ADC_REF_VAL) * ADC_REF_VOL;
			NTC_R = (((TEMP_REF_VOL-Temp_Vadc)*TEMP_RES_VAL)/Temp_Vadc) - 600;    //Rntc = ((5.0 - Vadc)*R分压) / Vadc
			TempVal[k] = Get_NTC_Temperature(NTC_R);
			
			DebugInqPara.Ro.Tpb[k] = TempVal[k];
		}
	}
}

/**********************************************************************************************************
**                                          End Of File
**********************************************************************************************************/

