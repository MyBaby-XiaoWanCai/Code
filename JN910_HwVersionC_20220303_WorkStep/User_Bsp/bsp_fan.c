/**********************************************************************************************************
** Company     : JNE WuHan Co.,Ltd.
** Project     :
** --------------------------------------------------------------------------------------------------------
** File name   : bsp_fan.c
** Author      : Huang Cheng
** Date        : 2022-01-06
** Description : bsp_fan source file
**********************************************************************************************************/

/**********************************************************************************************************
**                                          头文件引用区
**********************************************************************************************************/
#include "tim.h"
#include "bsp_fan.h"

/**********************************************************************************************************
**                                         全局变量定义区
**********************************************************************************************************/

/**********************************************************************************************************
**                                           函数声明区
**********************************************************************************************************/


/**********************************************************************************************************
**                                           应用函数区
**********************************************************************************************************/

/**********************************************************************************************************
**	函 数 名 : bsp_FanInit()
**	功能说明 : 风扇初始化，开启PWM输出
**	形    参 : 无
**	返 回 值 : 无
**********************************************************************************************************/
void bsp_FanInit(void)
{
	MX_TIM2_Init();
	HAL_TIM_PWM_Start(&htim2, TIM_CHANNEL_1);
}

/**********************************************************************************************************
**	函 数 名 : bsp_FanSpdSet()
**	功能说明 : 风扇速度设置，占空比∈[0.1, 1.0]
**	形    参 : Iout - DCDC输出电流大小
**	返 回 值 : 无
**********************************************************************************************************/
void bsp_FanSpdSet(uint16_t Iout)
{
	uint16_t DutyVal = 0;
	
	/* 入口参数有效性检查 */
	if(Iout > CHARGE_CURT_MAX)
	{
		Iout = CHARGE_CURT_MAX;
	}
	
	DutyVal = ((Iout/CHARGE_CURT_MAX)*(FAN_SPDMAX_NUM-FAN_SPD_OFFSET)) + FAN_SPD_OFFSET;   //最大可设置200A充电电流
	
	TIM2->CCR1 = DutyVal - 0x01;
}

/**********************************************************************************************************
**	函 数 名 : bsp_FanStop()
**	功能说明 : 风扇停止函数，用于风扇发生故障时
**	形    参 : 无
**	返 回 值 : 无
**********************************************************************************************************/
void bsp_FanStop(void)
{
	//设置占空比为0
	TIM2->CCR1 = 0x00;
}

/**********************************************************************************************************
**	函 数 名 : bsp_FanErrDetect()
**	功能说明 : 风扇故障检测函数
**	形    参 : 无
**	返 回 值 : FanSta - FAN_OK风扇无故障，FAN_ERR - 风扇故障
**********************************************************************************************************/
Fan_StaType bsp_FanErrDetect(void)
{
	Fan_StaType FanSta = FAN_OK;
	
	if(0x01 == HAL_GPIO_ReadPin(Fan_error_GPIO_Port, Fan_error_Pin))
	{
		bsp_DelayMS(5);
		
		if(0x01 == HAL_GPIO_ReadPin(Fan_error_GPIO_Port, Fan_error_Pin))
		{
			FanSta = FAN_ERR;
		}
	}
	
	return FanSta;
}

/**********************************************************************************************************
**                                          End Of File
**********************************************************************************************************/

